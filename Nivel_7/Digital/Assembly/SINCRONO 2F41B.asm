;Autor			:Angie Marchena
;Fecha			:09-04-2021
;Version 		:MPLAB IDE v8.91
;Titulo			:SINCRONO 2F41B
;Descripcion	:ENCENCER DISPLAY DE 7SEG.

		LIST	P=16F628A
		INCLUDE	<P16F628A.INC>

;--Declaracion de variable--
status		equ	03h
portb		equ 06h
trisb		equ	86h
pcl			equ	02h
contador1	equ	20h
contador2	equ	21h
contador3	equ	22h
contador4	equ	23h

;--Programa--;

			org		00h;SE ESCRIBE LA LINEA 0 DE LA INSTRUCCION
			goto	start;SALTA A LA LINEA ETIQUETADA CON INICIO
			org		05h;LAS SIGUIENTES LINEAS SE ESCRIBIRAN DESDE LA DIRECCION

;--Display_Siete_Segmetos--;

tabla:		
			addwf	02h,f;SUMA DEL CONTENIDO DEL REGISTRO F
			retlw	b'10110110';ENCIENDE 2
			retlw	b'11100010';ENCIENDE F
			retlw	b'11001100';ENCIENDE 4
			retlw	b'00001100';ENCIENDE 1
			retlw	b'11111000';ENCIENDE B
			

retardo:
		
			movlw	0ffh		;CARGA EL NUMERO EN EL ACUMULADOR 0ffh
			movwf	contador2	;MUEVE UNA COPIA DEL REGISTRO DE TRABAJO AL REGISTRO CONTADOR2
			movlw	0ffh		;CARGA EL NUMERO EN EL ACUMULADOR 0ffh
			movwf	contador3	;MUEVE UNA COPIA DEL REGISTRO DE TRABAJO AL REGISTRO CONTADOR3
			decfsz	contador3,1 ;DECREMENTA EL CONTADOR3
			goto	$-1			;SALTA A LA ETIQUETA HACIA ATRAS UNO
			decfsz	contador2,1 ;DECREMEMTA EL CONTADOR2
			goto	$-4			;SALTA A LA ETIQUETA HACIA ATRAS CUATRO
			retlw	0			;REGRESA DE UNA SUBRUTINA CON EL NUMERO 0 EN EL ACUMULADOR
start:
			bsf 	status,5  	;CAMBIA DE PAG0 A PAG1 
			movlw	b'00000001' ;CARGA EL 00000001 EN EL ACUMULADOR W
			movwf	trisb		;MUEVE UNA COPIA DEL REGISTRO DE TRABAJO AL REGISTRO DE TRISB
			bcf		status,5	;PASO DEL BANCO 1 AL AL BANCO 0
			clrf	portb       ;LIMPIEZA DEL PORTB
			clrf	contador4   ;LIMPIEZA DEL CONTADOR4
main:
			movf	contador4,w ;MUEVE UNA COPIA DEL REGISTRO CONTADOR4 AL DESTINO W
			call	tabla		;LLAMAR A LA SUBRUTINA DE TABLA
			movwf	portb		;MOVER UNA COPIA DEL REGISTRO DE TRABAJO AL REGISTRO PORTB
			call	retardo		;LLAMAR A SUBRUTINA DE RETARDO
			call	retardo		;LLAMAR A SUBRUTINA DE RETARDO
			incf	contador4,f ;INCREMENTAR EL REGISTRO CONTADOR4 AL REGISTRO
			movlw	b'0101'		;CARGA 0101 EN EL REGISTRO DE TRABAJO
			subwf	contador4,w ;EJECUTA LA RESTA DEL CONTADOR4 CON W
			btfss	status,2	;SALTA LA SIGUIENTE INTRUCCION SI ES 1
			goto	main		;SALTA A LA ETIQUETA LLAMADA MAIN
			clrf	contador4 	;LIMPIENZA EN EL CONTADOR4

			end					;FIN
			
			

			
			